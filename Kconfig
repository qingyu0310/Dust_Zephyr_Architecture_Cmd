## Kconfig
```kconfig
config DUST_CMD_SHELL
    bool "Self-maintained UART debug console (thread + command dispatch)"
    default n
    select DUST_COM_UART_DMA
    help
        Common shell thread: UART receive loop + command dispatch.
        var/log sub-commands are gated by their own symbols.

config DUST_CMD_SHELL_VAR
    bool "var sub-commands (var list/get/set)"
    default n
    select DUST_CMD_SHELL
    help
        Debug variable interaction: var list (list), var get <name>,
        var set <name> <v>. Threads register variables via REGISTER_SHELL_VAR().

config DUST_CMD_SHELL_LOG
    bool "DUST_LOG system + log sub-commands (log list/on/off)"
    default n
    select DUST_CMD_SHELL
    help
        Self-made DMA log system: INF/ERR/OK/WRN direct print (4 colors),
        DBG selectable streaming via log on/off. Requires the shell thread.

config DUST_CMD_BUZZER
    bool "Enable PWM buzzer control"
    default n
    select DUST_DEV_PWM
    help
        Enable buzzer control class based on PWM output.

config DUST_CMD_W25Q128
    bool "Enable W25Q128 SPI NOR Flash driver"
    default n
    select DUST_COM_SPI
    help
        Enable W25Q128 SPI NOR Flash driver for read/write/erase operations.

config DUST_CMD_FLASH
    bool "Enable Flash partition support"
    default n
    select DUST_CMD_W25Q128
    help
        Flash partition layout and allocation for cmd/flash.
```

## create/skeleton/project/Kconfig
```kconfig
# 用户区业务门禁 Kconfig
# 业务门禁符号（PRJ_MAIN / TRD_XXX / USE_XXX）保持原名，不加 DUST_ 前缀
# 业务门禁 select 的架构符号统一 DUST_ 前缀

config PRJ_MAIN
    bool "Main business project"
    default n

if PRJ_MAIN

# ============================================================================

# =================       功能配置区 — 各模块开关       ========================

config USE_CMD_SHELL
    bool "Shell debug console (thread + var/log)"
    default n
    select DUST_CMD_SHELL_LOG
    select DUST_CMD_SHELL_VAR
    help
      Shell debug console - UART thread + var/log sub-commands.
      打开需要 overlay 里配 shell-uart 别名，否则 shell.cpp 编译报错。

config USE_CMD_BUZZER
    bool "Buzzer control"
    default n
    select DUST_CMD_BUZZER
    help
      Buzzer control - PWM beep via cmd/buzzer.

config USE_CMD_FLASH
    bool "SPI Flash"
    default n
    select DUST_CMD_FLASH
    help
      SPI NOR Flash read/write/erase via cmd/flash.

# ============================================================================

# =================               TRD_XXX                 ====================
# 新增业务线程时照下面这块追加，并在 project/thread/CMakeLists.txt 加对应 if 块
#
# config TRD_XXX
#     bool "XXX thread"
#     default n
#     select DUST_DEV_XXX
#     help
#       XXX thread description.

# ============================================================================

endif # PRJ_MAIN

source "Kconfig.zephyr"
```
